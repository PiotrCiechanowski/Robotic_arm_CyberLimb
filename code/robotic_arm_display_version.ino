#include <Button.h>
#include <SPI.h>
#include <Wire.h>
#include <Adafruit_GFX.h>
#include <Adafruit_SSD1306.h> 
#include <Fonts/FreeSans9pt7b.h>

#define OLED_ADDR   0x3C
#define OLED_RESET 4
#define SCREEN_WIDTH 128 // OLED display width, in pixels
#define SCREEN_HEIGHT 64 // OLED display height, in pixels
Adafruit_SSD1306 display(SCREEN_WIDTH, SCREEN_HEIGHT, &Wire, OLED_RESET);

Button upBtn(A1); 
Button selectBtn(A2); 
Button downBtn(A3); 

byte menuCount = 1;

#include <SoftwareSerial.h> 
#include <Servo.h> 
Servo myservo1, myservo2, myservo3, myservo4, myservo5; 
int bluetoothTx = 7; 
int bluetoothRx = 8; 
SoftwareSerial bluetooth(bluetoothTx, bluetoothRx);


const unsigned char myBitmap [] PROGMEM = 
{
  0x00, 0x00, 0x00, 0x00, 0x00, 0x00, 0x00, 0x00, 0x00, 0x00, 0x00, 0x00, 0x00, 0x00, 0x00, 0x00, 
	0x00, 0x00, 0x00, 0x00, 0x00, 0x00, 0x00, 0x00, 0x00, 0x00, 0x00, 0x00, 0x00, 0x00, 0x00, 0x00, 
	0x00, 0x00, 0x01, 0xe0, 0x00, 0x10, 0x00, 0x00, 0x00, 0x00, 0x00, 0x00, 0x00, 0x00, 0x00, 0x00, 
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	0x00, 0x00, 0x00, 0x03, 0xf8, 0x00, 0x00, 0x00, 0x00, 0x00, 0x00, 0x00, 0x00, 0x00, 0x00, 0x00
};

const unsigned char bitmap_screenshot_qr1 [] PROGMEM = {
 0xff, 0xff, 0xff, 0xff, 0x00, 0x00, 0x3f, 0xc0, 0x0f, 0x9c, 0x00, 0x00, 0xff, 0xff, 0xff, 0xff, 
 0xff, 0xff, 0xff, 0xff, 0x00, 0x00, 0x3f, 0xc0, 0x0f, 0x9c, 0x00, 0x00, 0xff, 0xff, 0xff, 0xff, 
 0xff, 0xff, 0xff, 0xff, 0x00, 0x00, 0x3f, 0xc0, 0x0f, 0x9c, 0x00, 0x00, 0xff, 0xff, 0xff, 0xff, 
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 0xff, 0xff, 0xff, 0xff, 0x00, 0x00, 0x39, 0xf0, 0x7c, 0x1c, 0x00, 0xf8, 0xff, 0xff, 0xff, 0xff
};

const unsigned char bitmap_screenshot [] PROGMEM = {
 0x00, 0x00, 0x00, 0x00, 0x00, 0x00, 0x00, 0x00, 0x00, 0x00, 0x00, 0x00, 0x00, 0x00, 0x15, 0xd7, 
 0x00, 0x00, 0x00, 0x00, 0x00, 0x00, 0x00, 0x00, 0x00, 0x00, 0x00, 0x00, 0x00, 0x00, 0x15, 0x45, 
 0x00, 0x00, 0x00, 0x00, 0x00, 0x00, 0x00, 0x00, 0x00, 0x00, 0x00, 0x00, 0x00, 0x00, 0x15, 0x96, 
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 0x00, 0x00, 0x00, 0x00, 0x00, 0x00, 0x00, 0x00, 0x00, 0x00, 0x00, 0x00, 0x00, 0x00, 0x00, 0x00
};

void setup() {
  
	upBtn.begin();
	selectBtn.begin();
	downBtn.begin();
	
	
	Serial.begin(9600);
  display.begin(SSD1306_SWITCHCAPVCC, OLED_ADDR);
  display.display();
  display.clearDisplay();


  display.begin(SSD1306_SWITCHCAPVCC, 0x3C); 
  display.clearDisplay();
  display.drawBitmap(0, 0, myBitmap, 128, 64, WHITE);
  display.display();
  delay(3000);


  myservo1.attach(4); 
  myservo2.attach(9);
  myservo3.attach(6);
  myservo4.attach(2);
  myservo5.attach(3);
  
  Serial.begin(9600);                                                          
  bluetooth.begin(9600);

}

void loop() {
  
  getButtonInput();
  staticMenu();
  menuInteract();
  display.clearDisplay();
  if(bluetooth.available()>= 2 )
  {
    unsigned int servopos = bluetooth.read();
    unsigned int servopos1 = bluetooth.read();
    unsigned int realservo = (servopos1 *256) + servopos;
    Serial.println(realservo);

    if (realservo >= 0 && realservo <180) {
      int servo1 = realservo;
      servo1 = map(servo1, 0, 180, 0, 180);
      myservo1.write(servo1);
      Serial.println("Servo 1 ON");
      delay(10);
    }
    if (realservo >= 181 && realservo <361) {
      int servo2 = realservo;
      servo2 = map(servo2, 181, 361, 0, 180);
      myservo2.write(servo2);
      Serial.println("Servo 2 ON");
      delay(10);
    }
    if (realservo >= 362 && realservo <542) {
      int servo3 = realservo;
      servo3 = map(servo3, 362, 542, 0, 180);
      myservo3.write(servo3);
      Serial.println("Servo 3 ON");
      delay(10);
    }
    if (realservo >= 543 && realservo <723) {
      int servo4 = realservo;
      servo4 = map(servo4, 543, 723, 0, 180);
      myservo4.write(servo4);
      Serial.println("Servo 4 ON");
      delay(10);
    }
    if (realservo >= 1000 && realservo <1180) {
      int servo5 = realservo;
      servo5 = map(servo5, 1000, 1180, 0, 180);
      myservo5.write(servo5);
      Serial.println("Servo 5 ON");
      delay(10);
    }
  }
}

void staticMenu() {
  // change text display here
  display.setTextSize(2);
  display.setTextColor(WHITE);

  display.setCursor(10, 0);
  // menu title
  display.println("ROBOT ARM");
  //---------------------------------
  display.setTextSize(0.5);
  display.setCursor(10, 20);
  // edit menu item here
  display.println("1. LOGO");
  display.setCursor(60, 20);

  display.setCursor(10, 30);
  // edit menu item here
  display.println("2. CODE QR");
  display.setCursor(60, 30);

  display.setCursor(10, 40);
  // edit menu item here
  display.println("3. IMAGES");
  display.setCursor(60, 40);
  
  // prints the cursor to highlight menu items
  display.setCursor(2, (menuCount * 10) + 10);
  display.println(">");

  display.display();
}



void getButtonInput() {
  // handles menu scrolling
  if (upBtn.pressed()) {
    if (menuCount <= 1)
      menuCount = 4;
    else
      menuCount--; 
  }
	
	if (downBtn.pressed()) {
	  if (menuCount >= 3)
	    menuCount = 1;
	  else
	    menuCount++;
	}
}

void menuInteract() {
  // handles select button input when a menu item is highlighted
  if (menuCount == 1 && selectBtn.pressed())
    // menu item 1 clicked
    function_one();
  else if (menuCount == 2 && selectBtn.pressed())
    // menu item 2 clicked
    function_two();
  else if (menuCount == 3 && selectBtn.pressed())
    // menu item 2 clicked
    function_three();
}

void function_one() {
  display.clearDisplay();
  display.drawBitmap(0, 0, myBitmap, 128, 64, WHITE);
  display.display();
  delay(3000);
  Serial.println('Function 1 Firing;');
}

void function_two() {
  display.clearDisplay();
  display.drawBitmap(0, 0, bitmap_screenshot_qr1, 128, 64, WHITE);
  display.display();
  delay(5000);
  Serial.println('Function 2 Firing;');
}

void function_three() {
  display.clearDisplay();
  display.drawBitmap(0, 0, bitmap_screenshot, 128, 64, WHITE);
  display.display();
  delay(5000);
  Serial.println('Function 3 Firing;');
}


